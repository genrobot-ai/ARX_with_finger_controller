/* USER CODE BEGIN Header */
/**
  ******************************************************************************
  * @file    usart.c
  * @brief   This file provides code for the configuration
  *          of the USART instances.
  ******************************************************************************
  * @attention
  *
  * Copyright (c) 2025 STMicroelectronics.
  * All rights reserved.
  *
  * This software is licensed under terms that can be found in the LICENSE file
  * in the root directory of this software component.
  * If no LICENSE file comes with this software, it is provided AS-IS.
  *
  ******************************************************************************
  */
/* USER CODE END Header */
/* Includes ------------------------------------------------------------------*/
#include "usart.h"

/* USER CODE BEGIN 0 */

#include <stdio.h>    //第一步重定向
#include <string.h>



uint8_t TxBuffer_tactile[] ={ 0x01,			//单条信息
															0x01,			//触觉
															0x00,0x00,0x00,0x00,0x00,0x00,0x01,0xC0,	//长度  448个 前面是L 后面是R
															0x00,0x00,0x00,0x00,0x00,0x00,0x00,0x00,0x00,0x00,  0x00,0x00,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0x00,   	//1 L
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															0x00,0x00,0x00,0x00,0x00,0x00,0x00,0x00,0x00,0x00,  0x00,0x00,0x00,0x00,0x00,0x00,0x00,0x00,0x00,0x00,  0x00,0x00,0x00,0x00,			//5		224 
															};	 //数据 
uint8_t TxBuffer_encoder[] = {0x01,		//单条信息
															0x03,		//encoder(编码器)
															0x00,0x00,0x00,0x00,0x00,0x00,0x00,0x04,//长度
															0x00,0x00,0x00,0x00};		//[10]

uint8_t TxBuffer_drive[] = {0x01,		//单条信息   
														0x02,		//drive电机
														0x00,0x00,0x00,0x00,0x00,0x00,0x00,0x04,//长度8
														0x00,0x00,0x00,0x00};		// [10]
uint8_t TxBuffer_writedrive[] = {0x01,		//写入电机驱动
																0x03,		//drive电机
																0x00,0x00,0x00,0x00,0x00,0x00,0x00,0x04,//长度8
																0x00,0x00,0x00,0x00};		// [10]
uint8_t TxBuffer_all[] ={   0x02,			//多条信息
														0x02,			//电机
														0x00,0x00,0x00,0x00,0x00,0x00,0x00,0x04,//长度4
														0x00,0x00,0x00,0x00,
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														0x00,0x00,0x00,0x00,0x00,0x00,0x00,0x00,0x00,0x00,  0x00,0x00,0x00,0x00,0x00,0x00,0x00,0x00,0x00,0x00,  0x00,0x00,0x00,0x00,			//5		224 
														
//														0x03,			//磁编码器 暂时不用了
//														0x00,0x00,0x00,0x00,0x00,0x00,0x00,0x04,//长度4
//														0x00,0x00,0x00,0x00
														};

// 2. 定义发送缓冲区的长度
uint16_t TxBuffer_tactileLength = sizeof(TxBuffer_tactile);
uint16_t TxBuffer_encoderLength = sizeof(TxBuffer_encoder);
uint16_t TxBuffer_driveLength = sizeof(TxBuffer_drive);			
uint16_t TxBuffer_allLength = sizeof(TxBuffer_all);	

														
uint8_t rxBuffer[RX_BUFFER_SIZE];
uint8_t txBuffer[TX_BUFFER_SIZE];
uint16_t rxLength = 0;
uint16_t txLength = 0;

uint8_t Uart_RxData;	 		//测试电机时需要的指令


/* USER CODE END 0 */

UART_HandleTypeDef huart1;
DMA_HandleTypeDef hdma_usart1_rx;
DMA_HandleTypeDef hdma_usart1_tx;

/* USART1 init function */

void MX_USART1_UART_Init(void)
{

  /* USER CODE BEGIN USART1_Init 0 */

  /* USER CODE END USART1_Init 0 */

  /* USER CODE BEGIN USART1_Init 1 */

  /* USER CODE END USART1_Init 1 */
  huart1.Instance = USART1;
  huart1.Init.BaudRate = 921600;
  huart1.Init.WordLength = UART_WORDLENGTH_8B;
  huart1.Init.StopBits = UART_STOPBITS_1;
  huart1.Init.Parity = UART_PARITY_NONE;
  huart1.Init.Mode = UART_MODE_TX_RX;
  huart1.Init.HwFlowCtl = UART_HWCONTROL_NONE;
  huart1.Init.OverSampling = UART_OVERSAMPLING_16;
  if (HAL_UART_Init(&huart1) != HAL_OK)
  {
    Error_Handler();
  }
  /* USER CODE BEGIN USART1_Init 2 */

  /* USER CODE END USART1_Init 2 */

}

void HAL_UART_MspInit(UART_HandleTypeDef* uartHandle)
{

  GPIO_InitTypeDef GPIO_InitStruct = {0};
  if(uartHandle->Instance==USART1)
  {
  /* USER CODE BEGIN USART1_MspInit 0 */

  /* USER CODE END USART1_MspInit 0 */
    /* USART1 clock enable */
    __HAL_RCC_USART1_CLK_ENABLE();

    __HAL_RCC_GPIOA_CLK_ENABLE();
    /**USART1 GPIO Configuration
    PA9     ------> USART1_TX
    PA10     ------> USART1_RX
    */
    GPIO_InitStruct.Pin = GPIO_PIN_9;
    GPIO_InitStruct.Mode = GPIO_MODE_AF_PP;
    GPIO_InitStruct.Speed = GPIO_SPEED_FREQ_HIGH;
    HAL_GPIO_Init(GPIOA, &GPIO_InitStruct);

    GPIO_InitStruct.Pin = GPIO_PIN_10;
    GPIO_InitStruct.Mode = GPIO_MODE_INPUT;
    GPIO_InitStruct.Pull = GPIO_NOPULL;
    HAL_GPIO_Init(GPIOA, &GPIO_InitStruct);

    /* USART1 DMA Init */
    /* USART1_RX Init */
    hdma_usart1_rx.Instance = DMA1_Channel5;
    hdma_usart1_rx.Init.Direction = DMA_PERIPH_TO_MEMORY;
    hdma_usart1_rx.Init.PeriphInc = DMA_PINC_DISABLE;
    hdma_usart1_rx.Init.MemInc = DMA_MINC_ENABLE;
    hdma_usart1_rx.Init.PeriphDataAlignment = DMA_PDATAALIGN_BYTE;
    hdma_usart1_rx.Init.MemDataAlignment = DMA_MDATAALIGN_BYTE;
    hdma_usart1_rx.Init.Mode = DMA_CIRCULAR;
    hdma_usart1_rx.Init.Priority = DMA_PRIORITY_HIGH;
    if (HAL_DMA_Init(&hdma_usart1_rx) != HAL_OK)
    {
      Error_Handler();
    }

    __HAL_LINKDMA(uartHandle,hdmarx,hdma_usart1_rx);

    /* USART1_TX Init */
    hdma_usart1_tx.Instance = DMA1_Channel4;
    hdma_usart1_tx.Init.Direction = DMA_MEMORY_TO_PERIPH;
    hdma_usart1_tx.Init.PeriphInc = DMA_PINC_DISABLE;
    hdma_usart1_tx.Init.MemInc = DMA_MINC_ENABLE;
    hdma_usart1_tx.Init.PeriphDataAlignment = DMA_PDATAALIGN_BYTE;
    hdma_usart1_tx.Init.MemDataAlignment = DMA_MDATAALIGN_BYTE;
    hdma_usart1_tx.Init.Mode = DMA_NORMAL;
    hdma_usart1_tx.Init.Priority = DMA_PRIORITY_MEDIUM;
    if (HAL_DMA_Init(&hdma_usart1_tx) != HAL_OK)
    {
      Error_Handler();
    }

    __HAL_LINKDMA(uartHandle,hdmatx,hdma_usart1_tx);

    /* USART1 interrupt Init */
    HAL_NVIC_SetPriority(USART1_IRQn, 0, 0);
    HAL_NVIC_EnableIRQ(USART1_IRQn);
  /* USER CODE BEGIN USART1_MspInit 1 */

  /* USER CODE END USART1_MspInit 1 */
  }
}

void HAL_UART_MspDeInit(UART_HandleTypeDef* uartHandle)
{

  if(uartHandle->Instance==USART1)
  {
  /* USER CODE BEGIN USART1_MspDeInit 0 */

  /* USER CODE END USART1_MspDeInit 0 */
    /* Peripheral clock disable */
    __HAL_RCC_USART1_CLK_DISABLE();

    /**USART1 GPIO Configuration
    PA9     ------> USART1_TX
    PA10     ------> USART1_RX
    */
    HAL_GPIO_DeInit(GPIOA, GPIO_PIN_9|GPIO_PIN_10);

    /* USART1 DMA DeInit */
    HAL_DMA_DeInit(uartHandle->hdmarx);
    HAL_DMA_DeInit(uartHandle->hdmatx);

    /* USART1 interrupt Deinit */
    HAL_NVIC_DisableIRQ(USART1_IRQn);
  /* USER CODE BEGIN USART1_MspDeInit 1 */

  /* USER CODE END USART1_MspDeInit 1 */
  }
}

/* USER CODE BEGIN 1 */
int fputc(int c, FILE *stream)    //重写fputc函数
{
 /*
    huart1是工具生成代码定义的UART1结构体，
    如果以后要使用其他串口打印，只需要把这个结构体改成其他UART结构体。
*/
    HAL_UART_Transmit(&huart1, (unsigned char *)&c, 1, 1000);   
    return 1;
}

// 最基本的DMA发送函数
void UART_Transmit_DMA(uint8_t *data, uint16_t length)
{
    // 等待上一次发送完成
    while(HAL_UART_GetState(&huart1) == HAL_UART_STATE_BUSY_TX);
    
    // 开始DMA发送
    HAL_UART_Transmit_DMA(&huart1, data, length);
}
/**
  * @brief  使用DMA发送数据包（HAL库版本）
  * @param  data: 要发送的数据指针   在函数中自动的添加帧头帧尾 das\r\n
  * @param  length: 数据长度
  * @retval HAL status: HAL_OK表示成功，其他表示失败
  */

HAL_StatusTypeDef DMA_Send_Packet(uint8_t* data, uint16_t length)
{
    // 检查参数有效性
    if (data == NULL) {
        return HAL_ERROR;
    }
    
    // 检查数据长度是否有效   触觉传感器1000个字节这条限制去掉不然发不出数据
//    if (length > (PACKET_MAX_LENGTH - PACKET_HEADER_SIZE * 2)) {
//        return HAL_ERROR;  // 数据长度过长
//    }
    
    // 静态缓冲区，确保在DMA传输期间有效
    static uint8_t tx_buffer[PACKET_MAX_LENGTH];
    
    // 构建完整数据包（添加帧头和帧尾）
    // 添加帧头"das\r\n"
    memcpy(tx_buffer, PACKET_HEADER, PACKET_HEADER_SIZE);
    
    // 复制有效数据
    memcpy(&tx_buffer[PACKET_HEADER_SIZE], data, length);
    
    // 添加帧尾"das\r\n"
    memcpy(&tx_buffer[PACKET_HEADER_SIZE + length], PACKET_END, PACKET_HEADER_SIZE);
    
    uint16_t packet_length = PACKET_HEADER_SIZE + length + PACKET_HEADER_SIZE;
    
    // 等待上一次DMA传输完成
    if (HAL_UART_GetState(&huart1) == HAL_UART_STATE_BUSY_TX) {
        // 可以添加超时等待
        uint32_t timeout = HAL_GetTick();
        while (HAL_UART_GetState(&huart1) == HAL_UART_STATE_BUSY_TX) {
            if (HAL_GetTick() - timeout > 100) {  // 100ms超时
                return HAL_TIMEOUT;
            }
        }
    }
    
    // 使用HAL库的DMA发送函数
    HAL_StatusTypeDef status = HAL_UART_Transmit_DMA(&huart1, tx_buffer, packet_length);
    
    return status;
}

// 判断函数
uint8_t is_mcuid_received(const uint8_t *data, uint16_t len) 
{
    if (len != 5) return 0;
    
    if(data[0] == 'M' && 
            data[1] == 'C' && 
            data[2] == 'U' && 
            data[3] == 'I' && 
            data[4] == 'D')
		{
			return 1;
		}
		else
		{
			return 0;
		}
}


/* USER CODE END 1 */
